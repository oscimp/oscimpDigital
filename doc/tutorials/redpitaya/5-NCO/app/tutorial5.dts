/dts-v1/;
/plugin/;

/ {
	compatible = "xlnx,zynq-7000";

	fragment0 {
		target = <&fpga_full>;
		#address-cells = <1>;
		#size-cells = <1>;
		__overlay__ {
			#address-cells = <1>;
			#size-cells = <1>;

			firmware-name = "tutorial5_wrapper.bit.bin";

			data1600: data1600@43C10000{
				compatible = "ggm,dataToRam";
				reg = <0x43C10000 0xffff>;
			};

			datanco: datanco@43C00000{
				compatible = "ggm,nco_counter";
				reg = <0x43C00000 0xffff>;
			};

		};
	};
};
