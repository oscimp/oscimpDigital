/dts-v1/;
/plugin/;

/ {
	compatible = "xlnx,zynq-7000";

	fragment0 {
		target = <&fpga_full>;
		#address-cells = <1>;
		#size-cells = <1>;
		__overlay__ {
			#address-cells = <1>;
			#size-cells = <1>;

			firmware-name = "tutorial3_wrapper.bit.bin";

			data1600: data1600@43c00000{
				compatible = "ggm,dataToRam";
				reg = <0x43c00000 0xffff>;
			};

		};
	};
};
