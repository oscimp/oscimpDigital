/dts-v1/;
/plugin/;

/ {
	compatible = "xlnx,zynq-7000";

	fragment0 {
		target = <&fpga_axi>;
		#address-cells = <1>;
		#size-cells = <1>;
		__overlay__ {
			#address-cells = <1>;
			#size-cells = <1>;

			select_cacode: select_cacode@43c20000{
				compatible = "ggm,fpgagen";
				reg = <0x43c20000 0xffff>;
			};

			data3200: data3200@43c30000{
				compatible = "ggm,dataToRam";
				reg = <0x43c30000 0xffff>;
			};

		};
	};
};
